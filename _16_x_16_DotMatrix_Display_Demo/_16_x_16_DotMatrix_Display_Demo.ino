#define LEDARRAY_D     2
#define LEDARRAY_C     3
#define LEDARRAY_B     4
#define LEDARRAY_A     5
#define LEDARRAY_G     6
#define LEDARRAY_DI    7
#define LEDARRAY_CLK   8
#define LEDARRAY_LAT   9

#define dly            16
#define times          6


unsigned char Display_Buffer[2];
const unsigned char  GIF1[1][32] = 
{
  0xFC,0xFB,0xF7,0xF5,0xF7,0xF7,0xF6,0xFB,0xFC,0xF0,0xF4,0xF4,0xE4,0xF8,0xF1,0xE1,
  0x3F,0xDF,0xEF,0xAF,0xEF,0xEF,0x6F,0xDF,0x3F,0x0F,0x2F,0x2F,0x27,0x1F,0x8F,0x87
};

const unsigned char GIF2[1][32] = 
{
  0xFC,0xFB,0xF7,0xF5,0xF7,0xF7,0xF6,0xFB,0xFC,0xF0,0xF4,0xF4,0xFC,0xF8,0xF1,0xE1,
  0x3F,0xDF,0xEF,0xAF,0xEF,0xEF,0x6F,0xDF,0x3F,0x0F,0x2F,0x2F,0x27,0x1F,0x8F,0x87
};

const unsigned char GIF3[1][32] = 
{
  0xFC,0xFB,0xF7,0xF5,0xF7,0xF7,0xF6,0xFB,0xFC,0xF0,0xFC,0xFC,0xFC,0xF8,0xF1,0xE1, 
  0x3F,0xDF,0xEF,0xAF,0xEF,0xEF,0x6F,0xDF,0x3F,0x0F,0x2F,0x2F,0x27,0x1F,0x8F,0x87 
};

const unsigned char GIF4[1][32] = 
{
  0xFC,0xFB,0xF7,0xF5,0xF7,0xF7,0xF6,0xFB,0xFC,0xC0,0xFC,0xFC,0xFC,0xF8,0xF1,0xE1, 
  0x3F,0xDF,0xEF,0xAF,0xEF,0xEF,0x6F,0xDF,0x3F,0x0F,0x2F,0x2F,0x27,0x1F,0x8F,0x87 
};

const unsigned char GIF5[1][32] = 
{
  0xFC,0xFB,0xF7,0xF5,0xF7,0xF7,0xF6,0x7B,0xBC,0xC0,0xFC,0xFC,0xFC,0xF8,0xF1,0xE1, 
  0x3F,0xDF,0xEF,0xAF,0xEF,0xEF,0x6F,0xDF,0x3F,0x0F,0x2F,0x2F,0x27,0x1F,0x8F,0x87 
};

const unsigned char GIF6[1][32] = 
{
  0xFC,0xFB,0xF7,0xF5,0xF7,0x75,0x76,0x7B,0xBC,0xC0,0xFC,0xFC,0xFC,0xF8,0xF1,0xE1,
  0x3F,0xDF,0xEF,0xAF,0xEF,0xAF,0x6F,0xDF,0x3F,0x0F,0x2F,0x2F,0x27,0x1F,0x8F,0x87 
};

const unsigned char GIF7[1][32] = 
{
  0xFC,0xFB,0xF7,0xF5,0xF7,0xD5,0xB6,0x7B,0xBC,0xC0,0xFC,0xFC,0xFC,0xF8,0xF1,0xE1,
  0x3F,0xDF,0xEF,0xAF,0xEF,0xAF,0x6F,0xDF,0x3F,0x0F,0x2F,0x2F,0x27,0x1F,0x8F,0x87 
};

const unsigned char  Init_Display[1][32] = 
{     
};


void setup()
{
  unsigned char i = 0;
 
  for(i = 2; i <= 9; i++)
  {
    pinMode(i, OUTPUT);
    digitalWrite(i, LOW);
  }
  Display(Init_Display);
}


void loop()
{
  unsigned int s = 0;
  unsigned int n = 0;
  
  for(s = 0; s < dly; s++)	
  {
    Display(GIF1);	
  }
  for(s = 0; s < dly; s++)	
  {
    Display(GIF2);	
  }
  for(s = 0; s < dly; s++)	
  {
    Display(GIF3);	
  }
  for(s = 0; s < dly; s++)	
  {
    Display(GIF4);	
  }
  for(n = 0; n < times; n++)
  {
      for(s = 0; s < dly; s++)	
      {
        Display(GIF6);	
      }
      for(s = 0; s < dly; s++)	
      {
        Display(GIF7);	
      }
  }
  for(s = 0; s < dly; s++)	
  {
    Display(GIF5);	
  }
  for(s = 0; s < dly; s++)	
  {
    Display(GIF4);	
  }
  for(s = 0; s < dly; s++)	
  {
    Display(GIF3);	
  }
}


void Display(const unsigned char dat[][32])					
{
  unsigned char i = 0;
  
  for(i = 0; i < 16; i++)
  {
    digitalWrite(LEDARRAY_G, HIGH);		
    
    Display_Buffer[0] = dat[0][i];		
    Display_Buffer[1] = dat[0][(i + 16)];
    
    Send(Display_Buffer[1]);
    Send(Display_Buffer[0]);
    
    digitalWrite(LEDARRAY_LAT, HIGH);
    digitalWrite(LEDARRAY_LAT, LOW);
    
    Scan_Line(i);	
    digitalWrite(LEDARRAY_G, LOW);
    delayMicroseconds(100);					
  }	
}


void Scan_Line(unsigned char x)
{	
  boolean state = 0;
  unsigned char p = 0;
  
  for(p = 0; p < 4; p++)
  {
    state = (x & 0x01);
    digitalWrite((LEDARRAY_A - p), state); 
    x >>= 1;
  }
}


void Send(unsigned char dat)
{
  unsigned char i = 0;
  
  digitalWrite(LEDARRAY_CLK, LOW);
  digitalWrite(LEDARRAY_LAT, LOW);

  for(i = 0; i < 8; i++)
  {
    if((dat & 0x01) == 0)
    {
      digitalWrite(LEDARRAY_DI, LOW);	
    }
    else
    {
      digitalWrite(LEDARRAY_DI, HIGH);
    }

    digitalWrite(LEDARRAY_CLK, HIGH);
    digitalWrite(LEDARRAY_CLK, LOW);
    		
    dat >>= 1;
  }			
}
